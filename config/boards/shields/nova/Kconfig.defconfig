## config/boards/shields/nova/Kconfig.defconfig
```kconfig
if SHIELD_NOVA_DONGLE

config ZMK_KEYBOARD_NAME
    default "Nova"

config ZMK_SPLIT_ROLE_CENTRAL
    default y

config ZMK_USB
    default y

endif

config ZMK_SPLIT_BLE_CENTRAL_PERIPHERALS
    default 2

if SHIELD_NOVA_LEFT || SHIELD_NOVA_RIGHT || SHIELD_NOVA_DONGLE

config ZMK_SPLIT
    default y

config ZMK_BLE
    default y

endif
```

## config/boards/shields/nova/Kconfig.shield
```kconfig
config SHIELD_NOVA_LEFT
    def_bool $(shields_list_contains,nova_left)

config SHIELD_NOVA_RIGHT
    def_bool $(shields_list_contains,nova_right)

config SHIELD_NOVA_DONGLE
    def_bool $(shields_list_contains,nova_dongle)
```
